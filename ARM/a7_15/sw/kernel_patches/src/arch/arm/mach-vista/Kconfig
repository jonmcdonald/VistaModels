## ARM/a7_15/sw/kernel_patches/src/arch/arm/mach-vista/Kconfig
```kconfig
config ARCH_VISTA
	bool "Vista" if ARCH_MULTI_V7
	select CONFIG_OF
 	select OF_VIDEOMODE
 	select FB_MODE_HELPERS
	select VIDEOMODE_HELPERS
	select ARM_GIC
 	select HAVE_SMP
	select COMMON_CLK
	select GENERIC_CLOCKEVENTS
	select ARM_GLOBAL_TIMER
	select CLKSRC_ARM_GLOBAL_TIMER_SCHED_CLOCK
	select ARM_AMBA
	help
	  Support for Vista Virtual Platform
```
